   /******************************************************************************

          版权所有 (C), 2011-2012, 信意电子科技(http://xydz123.taobao.com/)

 ******************************************************************************
  文 件 名   : oled.c
  版 本 号   : v1.1
  作    者   : Guokaiyi
  生成日期   : 2012-12-1
  最近修改   : 
  功能描述   : LED128x64OLED显示屏底层驱动
  修改历史   :
  1.日    期   : 2012-11-10
    作    者   : Guokaiyi
    修改内容   : 创建文件
    、
  2.日    期   : 2012-12-1
    作    者   : Guokaiyi
    修改内容   : 修复F6x8字符数组的bug，
                 该bug会导致LED_P6x8Char，LED_P6x8Str显示错误

******************************************************************************/




#include "OLED.h"
#include <stdint.h>

uint8 OLED_GRAM[128][8];

/*===================================================================
=== 函数：
=== 用途：显示屏端口引脚宏定义设置
=== 作者：JONE
=== 修改：
=== 备注：
====================================================================*/
#define LED_SCL_1() 	gpio_set(PTB11,1)         /* SCL = 1 */
#define LED_SCL_0() 	gpio_set(PTB11,0)         /* SCL = 0 */
	
#define LED_SDA_1() 	gpio_set(PTB10,1)         /* SDA = 1 */
#define LED_SDA_0() 	gpio_set(PTB10,0)         /* SDA = 0 */
	
#define LED_RST_1() 	gpio_set(PTB16,1)         /* RST = 1 */
#define LED_RST_0() 	gpio_set(PTB16,0)         /* RST= 0 */
	
#define LED_DC_1()  	gpio_set(PTB17,1)         /* DC = 1 */
#define LED_DC_0()  	gpio_set(PTB17,0)         /* DC = 0 */




/*===================================================================
=== 函数：
=== 用途：OLED显示屏端口初始化
=== 作者：JONE
=== 修改：
=== 备注：
====================================================================*/
void OLED_CfgGpio(void)
{
    gpio_init(PTB10,GPO,0);
    gpio_init(PTB11,GPO,0);
    gpio_init(PTB16,GPO,0);
    gpio_init(PTB17,GPO,0);
    
}


/*----------------------------------------------------------------------------*
 * 宏定义                                                                     *
 *----------------------------------------------------------------------------*/
 void SYSTEM_TIME_Delay(uint32_t usTime)
{
    uint32_t i;
    uint32_t j;
    
    for (i = (uint32_t)100 * usTime; i > 0; i--)
    {
        for(j = 210; j > 0; j--)
        {
        }
    }
    
    return;
}
  
/*----------------------------------------------------------------------------*
 * 全局变量                                                                   *
 *----------------------------------------------------------------------------*/
const uint8_t F6x8[][6] =
{
    { 0x00, 0x00, 0x00, 0x00, 0x00, 0x00 },   //sp0
    { 0x00, 0x00, 0x00, 0x2f, 0x00, 0x00 },   // !1
    { 0x00, 0x00, 0x07, 0x00, 0x07, 0x00 },   // "2
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    { 0x14, 0x14, 0x14, 0x14, 0x14, 0x14 }    // horiz lines91
};

//中文字符串原字
const uint8_t F14x16_Idx[] = 
{
    "信意电子科技屏幕测试大学"
};

//中文字符串编码
const uint8_t F14x16[] = 
{  
    0x00,0x80,0xE0,0x1C,0x12,0x10,0x50,0x52,0x4C,0x50,0x50,0x30,0x08,0x00,
    0x01,0x00,0x7F,0x00,0x00,0x01,0x7D,0x45,0x45,0x45,0x45,0x7C,0x00,0x00,/*"信",0*/
    0x00,0x20,0x20,0xA8,0xA8,0xB8,0xA6,0xA8,0xB8,0x68,0xA8,0x20,0x20,0x00,
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    0x00,0x00,0x1F,0x60,0x10,0x28,0x21,0x1F,0x10,0x13,0x1C,0x20,0x70,0x00,/*"试",9*/
    //-- 大 --
    0x01,0x00,0x01,0x00,0x01,0x00,0x01,0x00,0x01,0x04,0xFF,0xFE,0x01,0x00,0x02,0x80,
      
      0x02,0x80,0x02,0x40,0x04,0x40,0x04,0x20,
      0x08,0x10,0x10,0x0E,0x60,0x04,0x00,0x00,
//-- 学 --
      0x22,0x08,0x11,0x08,0x11,0x10,0x00,0x20,
      0x7F,0xFE,0x40,0x02,0x80,0x04,0x1F,0xE0,
      0x00,0x40,0x01,0x84,0xFF,0xFE,0x01,0x00,
      0x01,0x00,0x01,0x00,0x05,0x00,0x02,0x00
};

//======================================================
// 128X64OLED液晶底层驱动[8X16]字体库
// 设计者: Guokaiyi
// 描  述: [8X16]西文字符的字模数据 (纵向取模,字节倒序)
// !"#$%&'()*+,-./0123456789:;<=>?@ABCDEFGHIJKLMNOPQRSTUVWXYZ[\]^_`abcdefghijklmnopqrstuvwxyz{|}~
//======================================================
const uint8_t F8X16[]=
{
    0x00,0x00,0x00,0x00,0x00,0x00,0x00,0x00,0x00,0x00,0x00,0x00,0x00,0x00,0x00,0x00,// 0
    0x00,0x00,0x00,0xF8,0x00,0x00,0x00,0x00,0x00,0x00,0x00,0x33,0x30,0x00,0x00,0x00,//!1
    0x00,0x10,0x0C,0x06,0x10,0x0C,0x06,0x00,0x00,0x00,0x00,0x00,0x00,0x00,0x00,0x00,//"2
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    0x00,0x06,0x01,0x01,0x02,0x02,0x04,0x04,0x00,0x00,0x00,0x00,0x00,0x00,0x00,0x00,//~94
};

const uint8_t F16x16_Idx[] = 
{
    "广东海洋大学舵电机跑道各参数阈值脉冲陀螺仪路障检测开关启动菜单步数距离卡路里高经纬速度"
};
const uint8_t F16x16[] = {

//-- 广 --
      0x00,0x00,0xFC,0x04,0x04,0x04,0x04,0x05,
      0x06,0x04,0x04,0x04,0x04,0x06,0x04,0x00,
      0x40,0x30,0x0F,0x00,0x00,0x00,0x00,0x00,
      0x00,0x00,0x00,0x00,0x00,0x00,0x00,0x00,
//-- 东 --
      0x08,0x08,0x08,0x88,0x68,0x18,0x0F,0xE8,
      0x08,0x08,0x08,0x88,0x08,0x0C,0x08,0x00,
      0x00,0x40,0x21,0x11,0x0D,0x41,0x81,0x7F,
      0x01,0x05,0x09,0x31,0x61,0x00,0x00,0x00,
//-- 海 --
      0x10,0x22,0x64,0x0C,0x90,0x08,0xF7,0x14,
      0x34,0x54,0x14,0x14,0xF6,0x04,0x00,0x00,
      0x04,0x04,0xFE,0x01,0x01,0x1F,0x11,0x11,
      0x13,0x15,0x51,0x91,0x7F,0x11,0x01,0x00,
//-- 洋 --
      0x10,0x22,0x64,0x0C,0x80,0x08,0x49,0x4A,
      0x4C,0xF8,0x4C,0x4A,0x49,0x08,0x00,0x00,
      0x04,0x04,0xFE,0x01,0x04,0x04,0x04,0x04,
      0x04,0xFF,0x04,0x04,0x04,0x06,0x04,0x00,
//-- 大 --
      0x20,0x20,0x20,0x20,0x20,0x20,0xA0,0x7F,
      0xA0,0x20,0x20,0x20,0x20,0x30,0x20,0x00,
      0x00,0x40,0x40,0x20,0x10,0x0C,0x03,0x00,
      0x01,0x06,0x08,0x10,0x20,0x60,0x20,0x00,
//-- 学 --
      0x40,0x30,0x11,0x96,0x90,0x90,0x91,0x96,
      0x90,0x90,0x98,0x14,0x13,0x50,0x30,0x00,
      0x04,0x04,0x04,0x04,0x04,0x44,0x84,0x7E,
      0x06,0x05,0x04,0x04,0x04,0x06,0x04,0x00,
//-- 舵 --
      0x80,0x80,0xFC,0x96,0xA5,0xFC,0x20,0x18,
      0xC8,0x09,0x0A,0x08,0x88,0x28,0x18,0x00,
      0x40,0x20,0x1F,0x42,0x84,0x7F,0x00,0x00,
      0x3F,0x44,0x42,0x41,0x40,0x70,0x00,0x00,
//-- 电 --
      0x00,0xF8,0x48,0x48,0x48,0x48,0xFF,0x48,
      0x48,0x48,0x48,0xFC,0x08,0x00,0x00,0x00,
      0x00,0x07,0x02,0x02,0x02,0x02,0x3F,0x42,
      0x42,0x42,0x42,0x47,0x40,0x70,0x00,0x00,
//-- 机 --
      0x10,0x10,0xD0,0xFF,0x90,0x10,0x00,0xFC,
      0x04,0x04,0x04,0xFE,0x04,0x00,0x00,0x00,
      0x04,0x03,0x00,0xFF,0x80,0x41,0x20,0x1F,
      0x00,0x00,0x00,0x3F,0x40,0x40,0x70,0x00,
//-- 跑 --
      0x00,0x3E,0x22,0xE2,0x22,0x7F,0x22,0xF8,
      0x27,0x24,0xF4,0x24,0x04,0xFE,0x04,0x00,
      0x20,0x7F,0x20,0x1F,0x11,0x11,0x00,0x3F,
      0x42,0x42,0x43,0x44,0x48,0x47,0x70,0x00,
//-- 道 --
      0x40,0x42,0x44,0xCC,0x00,0x04,0xE5,0xB6,
      0xAC,0xA4,0xA4,0xA6,0xF5,0x24,0x00,0x00,
      0x00,0x40,0x20,0x1F,0x20,0x40,0xBF,0xA4,
      0xA4,0xA4,0xA4,0xA4,0xBF,0xC0,0x40,0x00,
//-- 各 --
      0x00,0x00,0x20,0x10,0x08,0x97,0xA4,0x44,
      0x44,0xA4,0x94,0x0C,0x00,0x00,0x00,0x00,
      0x02,0x02,0x02,0x01,0xFD,0x44,0x44,0x44,
      0x44,0x44,0x44,0xFD,0x01,0x03,0x01,0x00,
//-- 参 --
      0x20,0x20,0x20,0x28,0xA8,0x6C,0x3B,0x28,
      0xA8,0x6A,0xAC,0x28,0x20,0x30,0x20,0x00,
      0x04,0x84,0x82,0x81,0x4A,0x4A,0x49,0x25,
      0x24,0x12,0x10,0x09,0x02,0x06,0x02,0x00,
//-- 数 --
      0x10,0x92,0x54,0x30,0xFF,0x50,0x94,0x32,
      0xD8,0x17,0x10,0x10,0xF0,0x18,0x10,0x00,
      0x02,0x82,0x4E,0x33,0x22,0x52,0x8E,0x40,
      0x23,0x14,0x08,0x16,0x61,0xC0,0x40,0x00,
//-- 阈 --
      0x00,0xFC,0x11,0xD2,0x50,0x52,0xD2,0x12,
      0xFE,0x12,0x16,0x9A,0x12,0xFF,0x02,0x00,
      0x00,0xFF,0x10,0x17,0x14,0x14,0x57,0x20,
      0x10,0x0F,0x12,0x39,0x80,0xFF,0x00,0x00,
//-- 值 --
      0x80,0x40,0x20,0xF8,0x07,0x04,0xE4,0xA4,
      0xA4,0xBF,0xA4,0xA4,0xF6,0x24,0x00,0x00,
      0x00,0x00,0x00,0xFF,0x40,0x40,0x7F,0x4A,
      0x4A,0x4A,0x4A,0x4A,0x7F,0x40,0x40,0x00,
//-- 脉 --
      0x00,0xFE,0x22,0x22,0xFF,0x42,0x48,0x48,
      0xC9,0xFA,0xC0,0x20,0x10,0x18,0x00,0x00,
      0x80,0x7F,0x02,0x82,0xFF,0x10,0x0C,0x43,
      0x80,0x7F,0x00,0x03,0x0C,0x18,0x08,0x00,
//-- 冲 --
      0x00,0x02,0x0C,0xE0,0x00,0xF0,0x10,0x10,
      0x10,0xFF,0x10,0x10,0x10,0xF8,0x10,0x00,
      0x02,0x02,0xFF,0x00,0x00,0x07,0x02,0x02,
      0x02,0xFF,0x02,0x02,0x02,0x07,0x00,0x00,
//-- 陀 --
      0x00,0xFE,0x02,0x22,0xDA,0x06,0x20,0x18,
      0xC8,0x09,0x0A,0x08,0x88,0x28,0x18,0x00,
      0x00,0xFF,0x08,0x10,0x08,0x07,0x00,0x00,
      0x3F,0x42,0x42,0x41,0x40,0x40,0x70,0x00,
//-- 螺 --
      0x00,0xF0,0x10,0xFF,0x10,0xF8,0x10,0x3E,
      0x2A,0xAA,0x7E,0x2A,0xAA,0x3F,0x02,0x00,
      0x20,0x67,0x22,0x1F,0x12,0x3B,0x40,0x25,
      0x55,0x85,0x7F,0x05,0x14,0x26,0x60,0x00,
//-- 仪 --
      0x80,0x40,0x20,0xF8,0x07,0x00,0x38,0xC0,
      0x02,0x04,0x0C,0x80,0x60,0x1C,0x00,0x00,
      0x00,0x00,0x00,0xFF,0x80,0x40,0x20,0x10,
      0x0B,0x04,0x0A,0x11,0x60,0xC0,0x40,0x00,
//-- 路 --
      0x00,0xFE,0x42,0xC2,0x42,0x7F,0x12,0x08,
      0x8C,0x57,0x24,0x54,0x8C,0x84,0x80,0x00,
      0x40,0x7E,0x40,0x3F,0x22,0x22,0x01,0xFF,
      0x42,0x42,0x42,0x42,0x42,0xFF,0x02,0x00,
//-- 障 --
      0x00,0xFE,0x22,0x5A,0x86,0x10,0xD2,0x56,
      0x5A,0x53,0x5A,0x56,0xF2,0x58,0x10,0x00,
      0x00,0xFF,0x04,0x08,0x17,0x10,0x17,0x15,
      0x15,0xFD,0x15,0x15,0x17,0x10,0x10,0x00,
//-- 检 --
      0x10,0x10,0xD0,0xFF,0x10,0x50,0x20,0x50,
      0x4C,0x43,0x4C,0x50,0x20,0x60,0x20,0x00,
      0x04,0x03,0x00,0xFF,0x41,0x42,0x42,0x5C,
      0x40,0x5F,0x40,0x50,0x4E,0x64,0x40,0x00,
//-- 测 --
      0x10,0x22,0x6C,0x00,0x80,0xFC,0x04,0xF4,
      0x04,0xFE,0x04,0xF8,0x00,0xFE,0x00,0x00,
      0x04,0x04,0xFE,0x01,0x40,0x27,0x10,0x0F,
      0x10,0x67,0x00,0x47,0x80,0x7F,0x00,0x00,
//-- 开 --
      0x80,0x82,0x82,0x82,0xFE,0x82,0x82,0x82,
      0x82,0x82,0xFE,0x82,0x83,0xC2,0x80,0x00,
      0x00,0x80,0x40,0x30,0x0F,0x00,0x00,0x00,
      0x00,0x00,0xFF,0x00,0x00,0x00,0x00,0x00,
//-- 关 --
      0x00,0x10,0x10,0x11,0x12,0x1C,0x10,0xF0,
      0x10,0x18,0x14,0x13,0x1A,0x90,0x00,0x00,
      0x81,0x81,0x41,0x41,0x21,0x11,0x0D,0x03,
      0x0D,0x11,0x21,0x21,0x41,0xC1,0x41,0x00,
//-- 启 --
      0x00,0x00,0x00,0xFC,0x44,0x44,0x44,0x45,
      0x46,0x44,0x44,0x44,0x44,0x7E,0x04,0x00,
      0x40,0x20,0x18,0x07,0xFE,0x42,0x42,0x42,
      0x42,0x42,0x42,0x42,0x42,0xFF,0x02,0x00,
//-- 动 --
      0x20,0x24,0x24,0xE4,0x26,0x34,0x20,0x10,
      0x10,0xFF,0x10,0x10,0x10,0xF8,0x10,0x00,
      0x08,0x1C,0x0B,0x08,0x08,0x8A,0x4C,0x30,
      0x0C,0x03,0x40,0x80,0x40,0x3F,0x00,0x00,
//-- 菜 --
      0x04,0x04,0x24,0x64,0xA4,0x2F,0x64,0xA4,
      0x24,0x2F,0x94,0x54,0x14,0x06,0x04,0x00,
      0x02,0x42,0x42,0x22,0x12,0x0A,0x06,0xFF,
      0x06,0x0A,0x12,0x12,0x22,0x63,0x22,0x00,
//-- 单 --
      0x00,0x00,0xF8,0x49,0x4A,0x4C,0x48,0xF8,
      0x48,0x4C,0x4A,0x49,0xFC,0x08,0x00,0x00,
      0x10,0x10,0x17,0x12,0x12,0x12,0x12,0xFF,
      0x12,0x12,0x12,0x12,0x13,0x18,0x10,0x00,
//-- 步 --
      0x40,0x40,0x40,0x40,0x7E,0x40,0x40,0xFF,
      0x48,0x48,0x48,0x4C,0x48,0x60,0x40,0x00,
      0x00,0x80,0x88,0x84,0x43,0x42,0x20,0x2F,
      0x10,0x10,0x0C,0x03,0x02,0x00,0x00,0x00,
//-- 数 --
      0x10,0x92,0x54,0x30,0xFF,0x50,0x94,0x32,
      0xD8,0x17,0x10,0x10,0xF0,0x18,0x10,0x00,
      0x02,0x82,0x4E,0x33,0x22,0x52,0x8E,0x40,
      0x23,0x14,0x08,0x16,0x61,0xC0,0x40,0x00,
//-- 距 --
      0x00,0x3E,0x22,0xE2,0x22,0x3E,0x00,0xFE,
      0x22,0x22,0x22,0x22,0xF3,0x22,0x00,0x00,
      0x20,0x7F,0x20,0x3F,0x12,0x12,0x00,0x7F,
      0x42,0x42,0x42,0x42,0x47,0x60,0x40,0x00,
//-- 离 --
      0x04,0x04,0x04,0xF4,0x04,0x8C,0x55,0x26,
      0x54,0x8C,0x04,0xF4,0x04,0x06,0x04,0x00,
      0x00,0xFC,0x04,0x05,0x25,0x35,0x2D,0x27,
      0x25,0x35,0x25,0x45,0x84,0x7E,0x04,0x00,
//-- 卡 --
      0x40,0x40,0x40,0x40,0x40,0x40,0xFF,0x44,
      0x44,0x44,0x46,0x44,0x40,0x60,0x40,0x00,
      0x00,0x00,0x00,0x00,0x00,0x00,0xFF,0x00,
      0x02,0x04,0x0C,0x18,0x00,0x00,0x00,0x00,
//-- 路 --
      0x00,0xFE,0x42,0xC2,0x42,0x7F,0x12,0x08,
      0x8C,0x57,0x24,0x54,0x8C,0x84,0x80,0x00,
      0x40,0x7E,0x40,0x3F,0x22,0x22,0x01,0xFF,
      0x42,0x42,0x42,0x42,0x42,0xFF,0x02,0x00,
//-- 里 --
      0x00,0x00,0xFE,0x12,0x12,0x12,0x12,0xFE,
      0x12,0x12,0x12,0x12,0xFF,0x02,0x00,0x00,
      0x40,0x48,0x49,0x49,0x49,0x49,0x49,0x7F,
      0x49,0x49,0x49,0x49,0x4D,0x68,0x40,0x00,
//-- 高 --
      0x04,0x04,0x04,0xF4,0x94,0x94,0x95,0x96,
      0x94,0x94,0x94,0xF4,0x04,0x06,0x04,0x00,
      0x00,0xFE,0x02,0x02,0x7A,0x4A,0x4A,0x4A,
      0x4A,0x4A,0x7A,0x02,0x82,0xFF,0x02,0x00,
//-- 经 --
      0x20,0x30,0x2C,0xA3,0x60,0x30,0x82,0x82,
      0x42,0x22,0x12,0x1A,0x26,0x42,0xC0,0x00,
      0x24,0x66,0x25,0x14,0x14,0x54,0x40,0x42,
      0x42,0x42,0x7E,0x42,0x42,0x62,0x40,0x00,
//-- 纬 --
      0x20,0x30,0xAC,0x63,0x30,0x48,0x48,0x48,
      0x48,0xFF,0x48,0x48,0x68,0x4C,0x08,0x00,
      0x22,0x63,0x22,0x12,0x12,0x12,0x02,0x02,
      0x02,0xFF,0x02,0x12,0x22,0x1F,0x02,0x00,
//-- 速 --
      0x40,0x42,0x44,0xCC,0x00,0xF4,0x94,0x94,
      0x94,0xFF,0x94,0x94,0x94,0xF6,0x04,0x00,
      0x00,0x40,0x20,0x1F,0x20,0x51,0x48,0x44,
      0x42,0x7F,0x42,0x44,0x4C,0x61,0x20,0x00,
//-- 度 --
      0x00,0x00,0xFC,0x24,0x24,0x24,0xFC,0xA5,
      0xA6,0xA4,0xFC,0x24,0x34,0x26,0x04,0x00,
      0x40,0x20,0x9F,0x80,0x42,0x42,0x26,0x2A,
      0x12,0x2A,0x26,0x42,0x40,0xC0,0x40,0x00
};      







/*----------------------------------------------------------------------------*
 * 内部函数原型                                                               *
 *----------------------------------------------------------------------------*/
void LED_WrDat(uint8_t ucData);
void LED_WrCmd(uint8_t ucCmd);
void LED_SetPos(uint8_t ucIdxX, uint8_t ucIdxY);
void SetStartColumn(uint8_t ucData);
void SetAddressingMode(uint8_t ucData);
void SetColumnAddress(uint8_t a, uint8_t b);
void SetPageAddress(uint8_t a, uint8_t b);
void SetStartLine(uint8_t d);
void SetContrastControl(uint8_t d);
void SetChargePump(uint8_t d);
void SetSegmentRemap(uint8_t d);
void SetEntireDisplay(uint8_t d);
void SetInverseDisplay(uint8_t d);
void SetMultiplexRatio(uint8_t d);
void SetDisplayOnOff(uint8_t d);
void SetStartPage(uint8_t d);
void SetCommonRemap(uint8_t d);
void SetDisplayOffset(uint8_t d);
void SetDisplayClock(uint8_t d);
void SetPrechargePeriod(uint8_t d);
void SetCommonConfig(uint8_t d);
void SetVCOMH(uint8_t d);
void SetNop(void);

/*----------------------------------------------------------------------------*
 * 外部函数原型                                                               *
 *----------------------------------------------------------------------------*/

/*****************************************************************************
 函 数 名  : LED_WrDat
 功能描述  : 向OLED写数据
 输入参数  : UCHAR8 ucData  
 输出参数  : NONE
 返 回 值  : NONE
*****************************************************************************/
void LED_WrDat(uint8_t ucData)
{
    uint8_t i = 8;
    LED_DC_1();
    LED_SCL_0();
    
    while (i--)
    { 
        if (ucData & 0x80)
        {
            LED_SDA_1();
        }
        else
        {
            LED_SDA_0();
        }
        
        LED_SCL_1(); 
        //delay_us(1); 
        LED_SCL_0();   
        ucData <<= 1;    
    }

    return;
}

/*****************************************************************************
 函 数 名  : LED_WrCmd
 功能描述  : 向OLED写命令
 输入参数  : UCHAR8 ucCmd  
 输出参数  : NONE
 返 回 值  : NONE
*****************************************************************************/
void LED_WrCmd(uint8_t ucCmd)
{
    uint8_t i = 8;
    LED_DC_0();
    LED_SCL_0();
    while (i--)
    { 
			  
        if (ucCmd & 0x80)
        {
            LED_SDA_1();
        }
        else
        {
            LED_SDA_0();
        }
        LED_SCL_1();
        //delay_us(1);           
        LED_SCL_0();   
        ucCmd <<= 1;   
    }  

    return;
}


/*****************************************************************************
 函 数 名  : LED_SetPos
 功能描述  : 设置坐标
 输入参数  : UCHAR8 ucIdxX  
             UCHAR8 ucIdxY  
 输出参数  : NONE
 返 回 值  : NONE
*****************************************************************************/
void LED_SetPos(uint8_t ucIdxX, uint8_t ucIdxY)
{ 
    LED_WrCmd(0xb0 + ucIdxY);
    LED_WrCmd(((ucIdxX & 0xf0) >> 4) | 0x10);
    LED_WrCmd((ucIdxX & 0x0f) | 0x00); 
} 

/*****************************************************************************
 函 数 名  : LED_Fill
 功能描述  : 对全屏写入同一个字符函数 
             如 LED_Fill(0x01);    对于某一位0为不亮 1为亮
            ------------------------------------------------------
                                共128列
                  1           1                1
              共  0           0                0
              8   0           0                0
              组  0       ……0     …………   0
              字  0           0                0
              符  0           0                0
              即  0           0                0
              8   0           0                0
              页  1           1                1
              64  0           0                0
              行  .           .                .
                  .           .    …………    .
                  .           .                . 
                  .           .                .
                  0           0                0
            ------------------------------------------------------
 输入参数  : UCHAR8 ucData  
 输出参数  : NONE                        LED_Fill(0xFF);//点亮全屏 
 返 回 值  : NONE
*****************************************************************************/
void LED_Fill(uint8_t ucData)
{
    uint8_t ucPage,ucColumn;
    
    for(ucPage = 0; ucPage < 8; ucPage++)
    {
        LED_WrCmd(0xb0 + ucPage);  //0xb0+0~7表示页0~7
        LED_WrCmd(0x00);           //0x00+0~16表示将128列分成16组其地址在某组中的第几列
        LED_WrCmd(0x10);           //0x10+0~16表示将128列分成16组其地址所在第几组
        for(ucColumn = 0; ucColumn < 134; ucColumn++)    //注意：9.6寸的显在128，1.3寸的为134  
        {
            LED_WrDat(ucData);
        }
    }
} 


/*************************************
*       凹槽显示
*       显示跑道信息
*
**************************************/
void LED_paodao(unsigned char L, unsigned char R )
  {
    uint8_t v;
     
    
        LED_WrCmd(0xb0 + 7);  //表示第7页
        LED_WrCmd(0x00);           //0x00+0~16表示将128列分成16组其地址在某组中的第几列
        LED_WrCmd(0x10);           //0x10+0~16表示将128列分成16组其地址所在第几组
        
        for(v = 0;v<128;v++) {
            if(v==L|| v==R) LED_WrDat(0xff); 
            else  LED_WrDat(0x00);
          }
   } 



/*****************************************************/

void SetStartColumn(uint8_t ucData)
{
    LED_WrCmd(0x00+ucData % 16);   // Set Lower Column Start Address for Page Addressing Mode
                                   // Default => 0x00
    LED_WrCmd(0x10+ucData / 16);   // Set Higher Column Start Address for Page Addressing Mode
                                   // Default => 0x10
}

void SetAddressingMode(uint8_t ucData)
{
    LED_WrCmd(0x20);        // Set Memory Addressing Mode
    LED_WrCmd(ucData);      // Default => 0x02
                            // 0x00 => Horizontal Addressing Mode
                            // 0x01 => Vertical Addressing Mode
                            // 0x02 => Page Addressing Mode
}

void SetColumnAddress(uint8_t a, uint8_t b)
{
    LED_WrCmd(0x21);        // Set Column Address
    LED_WrCmd(a);           // Default => 0x00 (Column Start Address)
    LED_WrCmd(b);           // Default => 0x7F (Column End Address)
}

void SetPageAddress(uint8_t a, uint8_t b)
{
    LED_WrCmd(0x22);        // Set Page Address
    LED_WrCmd(a);           // Default => 0x00 (Page Start Address)
    LED_WrCmd(b);           // Default => 0x07 (Page End Address)
}

void SetStartLine(uint8_t ucData)
{
    LED_WrCmd(0x40|ucData); // Set Display Start Line
                            // Default => 0x40 (0x00)
}

void SetContrastControl(uint8_t ucData)
{
    LED_WrCmd(0x81);        // Set Contrast Control
    LED_WrCmd(ucData);      // Default => 0x7F
}

void SetChargePump(uint8_t ucData)
{
    LED_WrCmd(0x8D);        // Set Charge Pump
    LED_WrCmd(0x10|ucData); // Default => 0x10
                            // 0x10 (0x00) => Disable Charge Pump
                            // 0x14 (0x04) => Enable Charge Pump
}

void SetSegmentRemap(uint8_t ucData)
{
    LED_WrCmd(0xA0|ucData); // Set Segment Re-Map
                            // Default => 0xA0
                            // 0xA0 (0x00) => Column Address 0 Mapped to SEG0
                            // 0xA1 (0x01) => Column Address 0 Mapped to SEG127
}

void SetEntireDisplay(uint8_t ucData)
{
    LED_WrCmd(0xA4|ucData); // Set Entire Display On / Off
                            // Default => 0xA4
                            // 0xA4 (0x00) => Normal Display
                            // 0xA5 (0x01) => Entire Display On
}

void SetInverseDisplay(uint8_t ucData)
{
    LED_WrCmd(0xA6|ucData); // Set Inverse Display On/Off
                            // Default => 0xA6
                            // 0xA6 (0x00) => Normal Display
                            // 0xA7 (0x01) => Inverse Display On
}

void SetMultiplexRatio(uint8_t ucData)
{
    LED_WrCmd(0xA8);        // Set Multiplex Ratio
    LED_WrCmd(ucData);      // Default => 0x3F (1/64 Duty)
}

void SetDisplayOnOff(uint8_t ucData)
{
    LED_WrCmd(0xAE|ucData); // Set Display On/Off
                            // Default => 0xAE
                            // 0xAE (0x00) => Display Off
                            // 0xAF (0x01) => Display On
}

void SetStartPage(uint8_t ucData)
{
    LED_WrCmd(0xB0|ucData); // Set Page Start Address for Page Addressing Mode
                            // Default => 0xB0 (0x00)
}

void SetCommonRemap(uint8_t ucData)
{
    LED_WrCmd(0xC0|ucData); // Set COM Output Scan Direction
                            // Default => 0xC0
                            // 0xC0 (0x00) => Scan from COM0 to 63
                            // 0xC8 (0x08) => Scan from COM63 to 0
}

void SetDisplayOffset(uint8_t ucData)
{
    LED_WrCmd(0xD3);        // Set Display Offset
    LED_WrCmd(ucData);      // Default => 0x00
}

void SetDisplayClock(uint8_t ucData)
{
    LED_WrCmd(0xD5);        // Set Display Clock Divide Ratio / Oscillator Frequency
    LED_WrCmd(ucData);      // Default => 0x80
                            // D[3:0] => Display Clock Divider
                            // D[7:4] => Oscillator Frequency
}

void SetPrechargePeriod(uint8_t ucData)
{
    LED_WrCmd(0xD9);        // Set Pre-Charge Period
    LED_WrCmd(ucData);      // Default => 0x22 (2 Display Clocks [Phase 2] / 2 Display Clocks [Phase 1])
                            // D[3:0] => Phase 1 Period in 1~15 Display Clocks
                            // D[7:4] => Phase 2 Period in 1~15 Display Clocks
}

void SetCommonConfig(uint8_t ucData)
{
    LED_WrCmd(0xDA);        // Set COM Pins Hardware Configuration
    LED_WrCmd(0x02|ucData); // Default => 0x12 (0x10)
                            // Alternative COM Pin Configuration
                            // Disable COM Left/Right Re-Map
}

void SetVCOMH(uint8_t ucData)
{
    LED_WrCmd(0xDB);        // Set VCOMH Deselect Level
    LED_WrCmd(ucData);      // Default => 0x20 (0.77*VCC)
}

void SetNop(void)
{
    LED_WrCmd(0xE3);        // Command for No Operation
}

/*****************************************************************************
 函 数 名  : LED_Init
 功能描述  : OLED初始化
 输入参数  : VOID  
 输出参数  : NONE
 返 回 值  : NONE
*****************************************************************************/
void OLED_Init(void)        
{
    
    
    OLED_CfgGpio();
	
    LED_SCL_1();
    LED_SDA_1();
    LED_RST_1();
    LED_DC_1();
	
    
    LED_SCL_1();      
    LED_RST_0();
    
    DELAY_MS(100);            //从上电到下面开始初始化要有足够的时间，即等待RC复位完毕      
    
    
    LED_RST_1();

    SetDisplayOnOff(0x00);     // Display Off (0x00/0x01)
    SetDisplayClock(0x80);     // Set Clock as 100 Frames/Sec
    SetMultiplexRatio(0x3F);   // 1/64 Duty (0x0F~0x3F)
    SetDisplayOffset(0x00);    // Shift Mapping RAM Counter (0x00~0x3F)
    SetStartLine(0x00);        // Set Mapping RAM Display Start Line (0x00~0x3F)
    SetChargePump(0x04);       // Enable Embedded DC/DC Converter (0x00/0x04)
    SetAddressingMode(0x02);   // Set Page Addressing Mode (0x00/0x01/0x02)
    SetSegmentRemap(0x01);     // Set SEG/Column Mapping     0x00左右反置 0x01正常
    SetCommonRemap(0x08);      // Set COM/Row Scan Direction 0x00上下反置 0x08正常
    SetCommonConfig(0x10);     // Set Sequential Configuration (0x00/0x10)
    SetContrastControl(0xCF);  // Set SEG Output Current
    SetPrechargePeriod(0xF1);  // Set Pre-Charge as 15 Clocks & Discharge as 1 Clock
    SetVCOMH(0x40);            // Set VCOM Deselect Level
    SetEntireDisplay(0x00);    // Disable Entire Display On (0x00/0x01)
    SetInverseDisplay(0x00);   // Disable Inverse Display On (0x00/0x01)  
    SetDisplayOnOff(0x01);     // Display On (0x00/0x01)
    LED_Fill(0x00);            // 初始清屏
    LED_SetPos(0,0);

    return;
} 
 
/*****************************************************************************
 函 数 名  : LED_P6x8Char
 功能描述  : 显示一个6x8标准ASCII字符
 输入参数  : UCHAR8 ucIdxX  显示的横坐标0~122
             UCHAR8 ucIdxY  页范围0～7
             UCHAR8 ucData  显示的字符
 输出参数  : NONE
 返 回 值  : NONE
*****************************************************************************/
void LED_P6x8Char(uint8_t ucIdxX, uint8_t ucIdxY, uint8_t ucData)
{
    uint8_t i, ucDataTmp;     
       
    ucDataTmp = ucData-32;
    if(ucIdxX > 122)
    {
        ucIdxX = 0;
        ucIdxY++;
    }
    
    LED_SetPos(ucIdxX, ucIdxY);
    
    for(i = 0; i < 6; i++)
    {     
        LED_WrDat(F6x8[ucDataTmp][i]);  
    }
}

/*****************************************************************************
 函 数 名  : LED_P8x16Char
 功能描述  : 显示一个16x8标准ASCII字符
 输入参数  : UCHAR8 ucIdxX  显示的横坐标0~112            【自创修改】
             UCHAR8 ucIdxY  页范围0～4
             UCHAR8 ucData  显示的字符
 输出参数  : NONE
 返 回 值  : NONE
*****************************************************************************/
void LED_P8x16Char(uint8_t ucIdxX, uint8_t ucIdxY, uint8_t ucData)
{
    uint8_t i, ucDataTmp;     
       
    ucDataTmp = ucData-32;
    if(ucIdxX > 112)
    {
        ucIdxX = 0;
        ucIdxY++;
    }
    
    LED_SetPos(ucIdxX, ucIdxY);
    
    for(i = 0; i < 8; i++) 
        {
            LED_WrDat(F8X16[(ucDataTmp << 4) + i]);
        }
        
        LED_SetPos(ucIdxX, ucIdxY + 1);   
        
        for(i = 0; i < 8; i++) 
        {
            LED_WrDat(F8X16[(ucDataTmp << 4) + i + 8]);
        }
        ucIdxX += 8;
}

/*****************************************************************************
 函 数 名  : LED_P6x8Str
 功能描述  : 写入一组6x8标准ASCII字符串
 输入参数  : UCHAR8 ucIdxX       显示的横坐标0~122
             UCHAR8 ucIdxY       页范围0～7
             UCHAR8 ucDataStr[]  显示的字符串
 输出参数  : NONE
 返 回 值  : NONE
*****************************************************************************/
void LED_P6x8Str(uint8_t ucIdxX, uint8_t ucIdxY,uint8_t ucDataStr[])
{
   uint8_t i, j, ucDataTmp; 

    for (j = 0; ucDataStr[j] != '\0'; j++)
    {    
        ucDataTmp = ucDataStr[j] - 32;
        if(ucIdxX > 122)
        {
            ucIdxX = 0;
            ucIdxY++;
        }
        
        LED_SetPos(ucIdxX,ucIdxY); 
        
        for(i = 0; i < 6; i++)
        {     
            LED_WrDat(F6x8[ucDataTmp][i]);  
        }
        ucIdxX += 6;
    }

    return;
}

/*****************************************************************************
 函 数 名  : LED_P8x16Str
 功能描述  : 写入一组8x16标准ASCII字符串
 输入参数  : UCHAR8 ucIdxX       为显示的横坐标0~120
             UCHAR8 ucIdxY       为页范围0～3
             UCHAR8 ucDataStr[]  要显示的字符串
 输出参数  : NONE
 返 回 值  : NONE
*****************************************************************************/
void LED_P8x16Str(uint8_t ucIdxX, uint8_t ucIdxY, uint8_t ucDataStr[])
{
    uint8_t i, j, ucDataTmp;

    ucIdxY <<= 1;
    
    for (j = 0; ucDataStr[j] != '\0'; j++)
    {    
        ucDataTmp = ucDataStr[j] - 32;
        if(ucIdxX > 120)
        {
            ucIdxX = 0;
            ucIdxY += 2;
        }
        LED_SetPos(ucIdxX, ucIdxY);   
        
        for(i = 0; i < 8; i++) 
        {
            LED_WrDat(F8X16[(ucDataTmp << 4) + i]);
        }
        
        LED_SetPos(ucIdxX, ucIdxY + 1);   
        
        for(i = 0; i < 8; i++) 
        {
            LED_WrDat(F8X16[(ucDataTmp << 4) + i + 8]);
        }
        ucIdxX += 8;
        
    }

    return;
}

/*****************************************************************************
 函 数 名  : LED_P14x16Str
 功能描述  : 写入一组14x16的中文字符串（字符串表格中需含有此字）
 输入参数  : UCHAR8 ucIdxX       为显示的横坐标0~114
             UCHAR8 ucIdxY       为页范围0～3
             UCHAR8 ucDataStr[]  要显示的中文字符串
 输出参数  : NONE
 返 回 值  : NONE
*****************************************************************************/
void LED_P14x16Str(uint8_t ucIdxX,uint8_t ucIdxY,uint8_t ucDataStr[])
{
    uint8_t i, j;
    uint32_t usAddress; 
    
    ucIdxY <<= 1;
    
    j = 0;
    while(ucDataStr[j] != '\0')
    {
        i = 0;
        usAddress = 1;
        while(F14x16_Idx[i] > 127)
        {
            if(F14x16_Idx[i] == ucDataStr[j])
            {
                if(F14x16_Idx[i + 1] == ucDataStr[j + 1])
                {
                    usAddress = i * 14;
                    break;
                }
            }
            i += 2;            
        }
        
        if(ucIdxX > 114)
        {
            ucIdxX = 0;
            ucIdxY += 2;
        }
        
        if(usAddress != 1)// 显示汉字                   
        {
            LED_SetPos(ucIdxX, ucIdxY);
            for(i = 0; i < 14; i++)               
            {
                LED_WrDat(F14x16[usAddress]);   
                usAddress++;
            }
            
            LED_SetPos(ucIdxX,ucIdxY + 1); 
            for(i = 0;i < 14;i++)          
            {
                LED_WrDat(F14x16[usAddress]);
                usAddress++;
            }
            
            j += 2;        
        }
        else              //显示空白字符            
        {
            LED_SetPos(ucIdxX,ucIdxY);
            for(i = 0;i < 14;i++)
            {
                LED_WrDat(0);
            }
            
            LED_SetPos(ucIdxX,ucIdxY + 1);
            for(i = 0;i < 14;i++)
            {           
                LED_WrDat(0);   
            }
            
            j++;
        }
        
        ucIdxX += 14;
    }

    return;
}

/*****************************************************************************
 函 数 名  : LED_P16x16Str
 功能描述  : 写入一组16x16的中文字符串（字符串表格中需含有此字）
 输入参数  : UCHAR8 ucIdxX       为显示的横坐标0~114
             UCHAR8 ucIdxY       为页范围0～3
             UCHAR8 ucDataStr[]  要显示的中文字符串
 输出参数  : NONE
 返 回 值  : NONE
*****************************************************************************/
void LED_P16x16Str(uint8_t ucIdxX,uint8_t ucIdxY,uint8_t ucDataStr[])
{
    uint8_t i, j;
    uint32_t usAddress; 
    
    ucIdxY <<= 1;
    
    j = 0;
    while(ucDataStr[j] != '\0')
    {
        i = 0;
        usAddress = 1;
        while(F16x16_Idx[i] > 127)
        {
            if(F16x16_Idx[i] == ucDataStr[j])
            {
                if(F16x16_Idx[i + 1] == ucDataStr[j + 1])
                {
                    usAddress = i * 16;
                    break;
                }
            }
            i += 2;            
        }
        
        if(ucIdxX > 112)
        {
            ucIdxX = 0;
            ucIdxY += 2;
        }
        
        if(usAddress != 1)// 显示汉字                   
        {
            LED_SetPos(ucIdxX, ucIdxY);
            for(i = 0; i < 16; i++)               
            {
                LED_WrDat(F16x16[usAddress]);   
                usAddress++;
            }
            
            LED_SetPos(ucIdxX,ucIdxY + 1); 
            for(i = 0;i < 16;i++)          
            {
                LED_WrDat(F16x16[usAddress]);
                usAddress++;
            }
            
            j += 2;        
        }
        else              //显示空白字符            
        {
            LED_SetPos(ucIdxX,ucIdxY);
            for(i = 0;i < 16;i++)
            {
                LED_WrDat(0);
            }
            
            LED_SetPos(ucIdxX,ucIdxY + 1);
            for(i = 0;i < 16;i++)
            {           
                LED_WrDat(0);   
            }
            
            j++;
        }
        
        ucIdxX += 16;
    }

    return;
}

/*****************************************************************************
 函 数 名  : LED_PXx16MixStr
 功能描述  : 输出14x16汉字和字符混合字符串 （字符串表格中需含有此字）
 输入参数  : UCHAR8 ucIdxX       为显示的横坐标0~114
             UCHAR8 ucIdxY       为页范围0～3
             UCHAR8 ucDataStr[]  要显示的中文字符串
 输出参数  : NONE
 返 回 值  : NONE
*****************************************************************************/
void LED_PXx16MixStr(uint8_t ucIdxX, uint8_t ucIdxY, uint8_t ucDataStr[])
{
    uint8_t ucTmpStr[3];
    uint8_t i = 0;    
    
    while(ucDataStr[i] != '\0')
    {
        if(ucDataStr[i] > 127)
        {
            ucTmpStr[0] = ucDataStr[i];
            ucTmpStr[1] = ucDataStr[i + 1];
            ucTmpStr[2] = '\0';          //汉字为两个字节
            LED_P14x16Str(ucIdxX, ucIdxY, ucTmpStr);  //显示汉字
            ucIdxX += 14;
            i += 2;
        }
        else
        {
            ucTmpStr[0] = ucDataStr[i];    
            ucTmpStr[1] = '\0';          //字母占一个字节
            LED_P8x16Str(ucIdxX, ucIdxY, ucTmpStr);  //显示字母
            ucIdxX += 8;
            i += 1;
        }
    }

    return;
} 

/*****************************************************************************
 函 数 名  : LED_PrintChar
 功能描述  : 将一个Char型数转换成3位数进行显示
 输入参数  : UCHAR8 ucIdxX    ucIdxX的范围为0～122
             UCHAR8 ucIdxY    ucIdxY的范围为0～7
             CHAR8 cData      cData为需要转化显示的数值 -128~127
 输出参数  : none
 返 回 值  : none
*****************************************************************************/
void LED_PrintChar(uint8_t ucIdxX, uint8_t ucIdxY, char cData)
{
    uint32_t i, j, k, usData;

    if(cData < 0)
    {
        LED_P6x8Char(ucIdxX, ucIdxY, '-');
        usData = (uint32_t)(-cData);  
    }
    else
    {
        LED_P6x8Char(ucIdxX, ucIdxY, '+');
        usData = (uint32_t)cData;
    }
    i = usData / 100;
    j = (usData % 100) / 10;
    k = usData % 10;
    
    LED_P6x8Char(ucIdxX+6, ucIdxY, i+48);
    LED_P6x8Char(ucIdxX+12, ucIdxY, j+48);
    LED_P6x8Char(ucIdxX+18, ucIdxY, k+48);   

    return;
}

/*****************************************************************************
 函 数 名  : LED_PrintChar
 功能描述  : 将一个Char型数转换成3位数进行显示
 输入参数  : UCHAR8 ucIdxX    ucIdxX的范围为0～122
             UCHAR8 ucIdxY    ucIdxY的范围为0～7                   【自创修改】
             CHAR8 cData      cData为需要转化显示的数值 -128~127
 输出参数  : none
 返 回 值  : none
*****************************************************************************/
void LED_8X16PrintChar(uint8_t ucIdxX, uint8_t ucIdxY,char cData)
{
    uint32_t i, j, k, usData;

    if(cData < 0)
    {
        LED_P8x16Char(ucIdxX, ucIdxY, '-');
        usData = (uint32_t)(-cData);  
    }
    else
    {
        LED_P8x16Char(ucIdxX, ucIdxY, '+');
        usData = (uint32_t)cData;
    }
    i = usData / 100;
    j = (usData % 100) / 10;
    k = usData % 10;
    
    LED_P8x16Char(ucIdxX+8, ucIdxY, i+48);
    LED_P8x16Char(ucIdxX+16, ucIdxY, j+48);
    LED_P8x16Char(ucIdxX+24, ucIdxY, k+48);   

    return;
}

/*****************************************************************************
 函 数 名  : LED_PrintChar
 功能描述  : 将一个Char型数转换成3位数进行显示
 输入参数  : UCHAR8 ucIdxX    ucIdxX的范围为0～122
             UCHAR8 ucIdxY    ucIdxY的范围为0～7                   【自创修改】
             CHAR8 cData      cData为需要转化显示的数值 -128~127
 输出参数  : none
 返 回 值  : none
*****************************************************************************/
void LED_8X16PrintChar_out(uint8_t ucIdxX, uint8_t ucIdxY,int cData)
{
    uint32_t i, j, k, usData;

    if(cData<=0)
    {
        usData = (uint32_t)(-cData); 
				LED_P8x16Char(ucIdxX, ucIdxY, '-');
    }
   else
    {
        usData = (uint32_t)cData;
			  LED_P8x16Char(ucIdxX, ucIdxY, '+');
    }
    i = usData / 100;
    j = (usData % 100) / 10;
    k = usData % 10;
    
    LED_P8x16Char(ucIdxX+8, ucIdxY, i+48);
    LED_P8x16Char(ucIdxX+16, ucIdxY, j+48);
    LED_P8x16Char(ucIdxX+24, ucIdxY, k+48);   

    return;
}

/*****************************************************************************
 函 数 名  : LED_PrintChar
 功能描述  : 将一个Char型数转换成3位数进行显示
 输入参数  : UCHAR8 ucIdxX    ucIdxX的范围为0～122
             UCHAR8 ucIdxY    ucIdxY的范围为0～7                   【自创修改】
             CHAR8 cData      cData为需要转化显示的数值 -128~127
 输出参数  : none
 返 回 值  : none
*****************************************************************************/
void LED_6X8PrintChar_out(uint8_t ucIdxX, uint8_t ucIdxY,char cData)
{
    uint32_t i, j, k, usData;

    if(cData < 0)
    {
        usData = (uint32_t)(-cData);  
    }
    else
    {
        usData = (uint32_t)cData;
    }
    i = usData / 100;
    j = (usData % 100) / 10;
    k = usData % 10;
    
    LED_P6x8Char(ucIdxX, ucIdxY, i+48);
    LED_P6x8Char(ucIdxX+6, ucIdxY, j+48);
    LED_P6x8Char(ucIdxX+12, ucIdxY, k+48);   

    return;
}


/*****************************************************************************
 函 数 名  : LED_PrintShort
 功能描述  : 将一个Short型数转换成5位数进行显示
 输入参数  : UCHAR8 ucIdxX ucIdxX的范围为0～120                  【自创修改的】
             UCHAR8 ucIdxY ucIdxY为页的范围0～7                   LED_P8x16Char
             SHORT16 sData  sData为需要转化显示的数值
 输出参数  : none
 返 回 值  : none
*****************************************************************************/
void LED_8x16PrintShort(uint8_t ucIdxX, uint8_t ucIdxY, unsigned int sData)
{
    uint32_t i, j, k, l, m, usData;  
    if(sData < 0)
    {
        //LED_P8x16Char(ucIdxX,ucIdxY,'-');
        usData = (uint32_t)(-sData);  
    }
    else
    {
        //LED_P8x16Char(ucIdxX,ucIdxY,'+');
        usData = (uint32_t)sData;
    }
    l = (usData % 100000) /10000;
    m = (usData % 10000) /1000;
    i = (usData % 1000) /100;
    j = (usData % 100) /10;
    k =  usData % 10;
    LED_P8x16Char(ucIdxX, ucIdxY, l+48);
    LED_P8x16Char(ucIdxX+8, ucIdxY, m+48);
    LED_P8x16Char(ucIdxX+16, ucIdxY, i+48);
    LED_P8x16Char(ucIdxX+24, ucIdxY, j+48);
    LED_P8x16Char(ucIdxX+32, ucIdxY, k+48);    

    return;
}

/*****************************************************************************
 函 数 名  : LED_PrintShort
 功能描述  : 将一个Short型数转换成5位数进行显示
 输入参数  : UCHAR8 ucIdxX ucIdxX的范围为0～120                  【自创修改的】
             UCHAR8 ucIdxY ucIdxY为页的范围0～7                   LED_P8x16Char
             SHORT16 sData  sData为需要转化显示的数值
 输出参数  : none      LED_P6x8Char
 返 回 值  : none
*****************************************************************************/
void LED_8x16PrintShort_out(uint8_t ucIdxX, uint8_t ucIdxY, int sData)
{
    uint32_t i, j, k, l, m, usData;  
    if(sData < 0)
    {
        usData = (uint32_t)(-sData);  
    }
    else
    {
        usData = (uint32_t)sData;
    }
    
    l = usData / 10000;
    m = (usData % 10000) /1000;
    i = (usData % 1000) / 100;
    j = (usData % 100) / 10;
    k = usData % 10;
		LED_P6x8Char(ucIdxX-6, ucIdxY, l+48);
	  LED_P6x8Char(ucIdxX, ucIdxY, m+48);
    LED_P6x8Char(ucIdxX+6, ucIdxY, i+48);
    LED_P6x8Char(ucIdxX+12, ucIdxY, j+48);
    LED_P6x8Char(ucIdxX+18, ucIdxY, k+48);  

    return;
}

/*****************************************************************************
 函 数 名  : LED_PrintShort
 功能描述  : 将一个Short型数转换成5位数进行显示
 输入参数  : UCHAR8 ucIdxX ucIdxX的范围为0～120
             UCHAR8 ucIdxY ucIdxY为页的范围0～7                   LED_P8x16Char
             SHORT16 sData  sData为需要转化显示的数值
 输出参数  : none
 返 回 值  : none
*****************************************************************************/
void LED_PrintShort(uint8_t ucIdxX, uint8_t ucIdxY, int sData)
{
    uint32_t i, j, k, l, m, usData;  
    if(sData < 0)
    {
        LED_P6x8Char(ucIdxX,ucIdxY,'-');
        usData = (uint32_t)(-sData);  
    }
    else
    {
        LED_P6x8Char(ucIdxX,ucIdxY,'+');
        usData = (uint32_t)sData;
    }
    
    l = usData / 10000;
    m = (usData % 10000) /1000;
    i = (usData % 1000) / 100;
    j = (usData % 100) / 10;
    k = usData % 10;
    LED_P6x8Char(ucIdxX+6, ucIdxY, l+48);
    LED_P6x8Char(ucIdxX+12, ucIdxY, m+48);
    LED_P6x8Char(ucIdxX+18, ucIdxY, i+48);
    LED_P6x8Char(ucIdxX+24, ucIdxY, j+48);
    LED_P6x8Char(ucIdxX+30, ucIdxY, k+48);  

    return;
}


/*****************************************************************************
 函 数 名  : LED_PrintImage
 功能描述  : 将图像显示出来
 输入参数  : UCHAR8 *pucTable     二维图像数组的地址
             USHORT16 usRowNum    二维图像的行数1~64
             USHORT16 usColumnNum 二维图像的列数1~128
 输出参数  : none
 返 回 值  : none
*****************************************************************************/
void LED_PrintImage(uint8_t *pucTable, uint32_t usRowNum, uint32_t usColumnNum)
{
    uint8_t ucData;
    uint32_t i,j,k,m,n;
    uint32_t usRowTmp;

    m = usRowNum >> 3;   //计算图片行数以8位为一组完整的组数
    n = usRowNum % 8;    //计算分完组后剩下的行数
    
    for(i = 0; i < m; i++) //完整组行扫描
    {
        LED_SetPos(0,(uint8_t)i);
        usRowTmp = i << 3;    //计算当前所在行的下标                  
        for(j = 0; j < usColumnNum; j++) //列扫描        
        {
            ucData = 0;
            for(k = 0; k < 8; k++) //在i组中对这8行扫描
            {
                ucData = ucData >> 1;
                if((pucTable + (usRowTmp + k) * usColumnNum)[j] == LED_IMAGE_WHITE)
                {
                    ucData = ucData | 0x80;
                }
                
            }
            LED_WrDat(ucData);
        }
    }
    
    LED_SetPos(0,(uint8_t)i); //设置剩下的行显示的起始坐标
    usRowTmp = i << 3;       //计算当前所在行的下标                  
    for(j = 0; j < usColumnNum; j++) //列扫描        
    {
        ucData = 0;
        for(k = 0; k < n; k++) //对剩下的行扫描
        {
            ucData = ucData >> 1;
            if((pucTable + (usRowTmp + k) * usColumnNum)[j] == LED_IMAGE_WHITE)
            {
                ucData = ucData | 0x80;
            }
            
        }
        ucData = ucData >> (8 - n);
        LED_WrDat(ucData);
    }

    return;
}


/********************************************/ /*
???: Dis_Float(char Y,char X,double real,char N) 
????:????? ?????? ??
????: x       ??x???    0~128
          y       ??y???    0~8
          real   ??????   ??????
          N       ??????? 1~5
????:
          ?
*//********************************************/
void Dis_Float(char ucIdxX,char ucIdxY,double real,char N) 
{
   
   char   n[12]={0};
   long   j=1;  
   uint32_t   real_int=0;
   double decimal=0;
   uint32_t   real_decimal=0;

	 
	 if(real<0) 
		 {
			 LED_P8x16Char(ucIdxX, ucIdxY, '-');
			 real_int = -real;
			 decimal=real_int-real;
		 }
	 else 
		 {
			 LED_P8x16Char(ucIdxX, ucIdxY, '+');
			 real_int=(int)real;
			 decimal=real-real_int;
		 }
   
   
   real_decimal=decimal*1e4;

   n[3]=(real_int/10)%10;
   n[4]=(real_int/1)%10; 
   n[5]='.';
   n[6]=(real_decimal/1000)%10;
   n[7]=(real_decimal/100)%10;
	 //n[8]=(real_decimal/10)%10;
   for(j=0;j<10;j++) n[j]=n[j]+16+32;
    n[5]='.';
	  LED_P8x16Char(ucIdxX+8, ucIdxY, n[3]);
	  LED_P8x16Char(ucIdxX+16, ucIdxY, n[4]);
	  LED_P8x16Char(ucIdxX+24, ucIdxY, n[5]);
	  LED_P8x16Char(ucIdxX+32, ucIdxY, n[6]);
		LED_P8x16Char(ucIdxX+40, ucIdxY, n[7]);
		//LED_P8x16Char(ucIdxX+48, ucIdxY, n[8]);
}         

void Dis_Float_1(char ucIdxX,char ucIdxY,double real,char N) 
{
   char   i_Count=1;
   char   n[12]={0};
   long   j=1;  
   uint32_t   real_int=0;
   double decimal=0;
   uint32_t   real_decimal=0;
   //ucIdxX=ucIdxX*8;
   real_int=(int)real;
   //Dis_Num(2,0,real_int,5);
   decimal=real-real_int;
   real_decimal=decimal*1e4;
   //Dis_Num(2,6,real_decimal,4);
   while(real_int/10/j!=0)
   {
      j=j*10;i_Count++;  
   } 
   //n[0]=(real_int/10000)%10; 
   //n[1]=(real_int/1000)%10;
   //n[2]=(real_int/100)%10;
   n[3]=(real_int/10)%10;
   n[4]=(real_int/1)%10; 
   n[5]='.';
   n[6]=(real_decimal/1000)%10;
   n[7]=(real_decimal/100)%10;
   n[8]=(real_decimal/10)%10;
   n[9]=real_decimal%10;
   n[6+N]='\0'; 
   for(j=0;j<10;j++) n[j]=n[j]+16+32;
   n[5]='.';
   n[6+N]='\0';   
	 //for(i=0;i<9;i++)
	  LED_P8x16Char(ucIdxX, ucIdxY, n[3]);
	  LED_P8x16Char(ucIdxX+8, ucIdxY, n[4]);
	  LED_P8x16Char(ucIdxX+16, ucIdxY, n[5]);
	  LED_P8x16Char(ucIdxX+24, ucIdxY, n[6]);
	  LED_P8x16Char(ucIdxX+32, ucIdxY, n[7]);
	  //LED_P8x16Char(ucIdxX+40, ucIdxY, n[7]);
		 //LED_P8x16Char(ucIdxX+48, ucIdxY, n[8]);
		 //LED_P8x16Char(ucIdxX+56, ucIdxY, n[7]);
		 //LED_P8x16Char(ucIdxX+64, ucIdxY, n[8]);
		 //LED_P8x16Char(ucIdxX+72, ucIdxY, n[9]);
		 //LED_P8x16Char(ucIdxX+80, ucIdxY, n[10]);
   //LED_P6x8Char(X,Y,n[5-i_Count]); 
}    

void Dis_Float_2(char ucIdxX,char ucIdxY,double real,char N) 
{
   char   i_Count=1;
   char   n[12]={0};
   long   j=1;  
   uint32_t   real_int=0;
   double decimal=0;
   uint32_t   real_decimal=0;
   //ucIdxX=ucIdxX*8;
   real_int=(int)real;
   //Dis_Num(2,0,real_int,5);
   decimal=real-real_int;
   real_decimal=decimal*1e4;
   //Dis_Num(2,6,real_decimal,4);
   while(real_int/10/j!=0)
   {
      j=j*10;i_Count++;  
   } 
   //n[0]=(real_int/10000)%10; 
   //n[1]=(real_int/1000)%10;
   //n[2]=(real_int/100)%10;
   //n[3]=(real_int/10)%10;
   n[4]=(real_int/1)%10; 
   n[5]='.';
   n[6]=(real_decimal/1000)%10;
   n[7]=(real_decimal/100)%10;
   n[8]=(real_decimal/10)%10;
   //n[9]=real_decimal%10;
   n[6+N]='\0'; 
   for(j=0;j<10;j++) n[j]=n[j]+16+32;
   n[5]='.';
   n[6+N]='\0';   
	 //for(i=0;i<9;i++)
	  LED_P8x16Char(ucIdxX, ucIdxY, n[4]);
	  LED_P8x16Char(ucIdxX+8, ucIdxY, n[5]);
	  LED_P8x16Char(ucIdxX+16, ucIdxY, n[6]);
	  LED_P8x16Char(ucIdxX+24, ucIdxY, n[7]);
	  LED_P8x16Char(ucIdxX+32, ucIdxY, n[8]);
	  //LED_P8x16Char(ucIdxX+40, ucIdxY, n[7]);
		 //LED_P8x16Char(ucIdxX+48, ucIdxY, n[8]);
		 //LED_P8x16Char(ucIdxX+56, ucIdxY, n[9]);
		 //LED_P8x16Char(ucIdxX+64, ucIdxY, n[8]);
		 //LED_P8x16Char(ucIdxX+72, ucIdxY, n[9]);
		 //LED_P8x16Char(ucIdxX+80, ucIdxY, n[10]);
   //LED_P6x8Char(X,Y,n[5-i_Count]); 
} 


void LED_DisNum(uint16_t x, uint16_t y, uint32_t num)
{
	uint32_t length = 0, temp = 0;
	temp = num;
	
	if( temp == 0 )
	{
		LED_P8x16Char(x, y, '0');
		return;
	}
	
	while( temp )
	{// 得到num的长度
		temp /= 10;
		length ++;
	}
	
	while( num )
	{
		/* 从个位开始显示 */
		LED_P8x16Char((x+8*(length--)-8), y, (num%10)+'0');
		num /= 10;
	}	
}


/*********************************************************************
Function:      OLED_Refresh_Gram(void);
Description:   更新GRAM到显存
Input:		   无
Output:		   无
*********************************************************************/
void OLED_Refresh_Gram(void)
{
	uint8 i,n;
	for(i=0;i<8;i++)
	{
		LED_WrCmd(0xb0+i);    //设置页地址（0~7）
		LED_WrCmd(0x00);      //设置显示位置—列低地址
		LED_WrCmd(0x10);      //设置显示位置—列高地址
		for(n=0;n<128;n++)
			LED_WrDat(OLED_GRAM[n][i]);
	}
}

/*********************************************************************
Function:      OLED_DrawPoint(u8 x,u8 y,u8 t);
Description:   画点函数，点亮屏幕上某个点
Input:		   x,y,t
					x:0~127
					y:0~63
					t:1 填充 0,清空
Output:			无
*********************************************************************/
void OLED_DrawPoint(uint8 x,uint8 y,uint8 t)
{
	uint8 pos,bx,temp=0;
	if(x>127||y>63)return;//超出范围了.
	pos=7-y/8;//确定页数，因为oled每次都是从最后一行开始写入的，所以用 7-y/8
	bx=y%8;
	temp=1<<(7-bx);//确定相应点在所属页的行位置
	if(t)
		OLED_GRAM[x][pos]|=temp;
	else
		OLED_GRAM[x][pos]&=~temp;
}
/*************************************
*       凹槽显示
*       显示跑道信息
*
**************************************/
void LED_paodao_2(void)
  {
   /* uint8 v,r, i=0, j = 0;
   unsigned char *b2;
   extern unsigned char img[CAMERA_H][CAMERA_W];  
    //b2=&img[5][80]; 
      for(r=0;r<8;r++)
       { 
        LED_WrCmd(0xb0 + r);  //表示第7页
        LED_WrCmd(0x00);           //0x00+0~16表示将128列分成16组其地址在某组中的第几列
        LED_WrCmd(0x10);           //0x10+0~16表示将128列分成16组其地址所在第几组
        //b2 = &img[r][0]; 
          for(v = 0;v<CAMERA_W;v++)
           {
              // b2+=2;
            if(img[r*CAMERA_H/8][v]==0x00) LED_WrDat(0x00);   //  if(img[r*CAMERA_H/8][v]==0x00) LED_WrDat(0x00); // ||v==19
              else  LED_WrDat(0xff);  
            }
       }*/
    uint8 i,j,k;
    for(j=0;j<60;j++)
    {
      for(i=0;i<80;i++)
      {
        k=img[j][i];
        OLED_DrawPoint(i,59-j,k);
      }
    }
    OLED_Refresh_Gram();
   
   } 